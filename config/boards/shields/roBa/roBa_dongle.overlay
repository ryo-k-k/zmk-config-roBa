/*
 * roBa_R.overlay
 * 右手側用の設定ファイル
 */
#include "roBa.dtsi" // もし共通定義ファイルがあれば

/* 右手側のキーマトリックス定義 */
&kscan0 {
    col-gpios
        = <&xiao_d 10 GPIO_ACTIVE_HIGH>
        , <&xiao_d 9 GPIO_ACTIVE_HIGH> 
        , <&xiao_d 8 GPIO_ACTIVE_HIGH> 
        , <&xiao_d 7 GPIO_ACTIVE_HIGH> 
        , <&gpio0 10 GPIO_ACTIVE_HIGH>
        ;
};

/* col-offsetも必要であればここに記述 */
&default_transform {
    col-offset = <6>;
};
