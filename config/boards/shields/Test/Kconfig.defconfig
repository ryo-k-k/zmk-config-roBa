## config/boards/shields/Test/Kconfig.defconfig
```kconfig
if SHIELD_ROBA_DONGLE

config ZMK_KEYBOARD_NAME
	default "roBa"

config ZMK_SPLIT_ROLE_CENTRAL
	default y

endif

if SHIELD_CHARYBDIS_DONGLE || SHIELD_ROBA_L || SHIELD_ROBA_R

config ZMK_SPLIT
	default y
	
endif
```

## config/boards/shields/roBa/Kconfig.defconfig
```kconfig
if SHIELD_ROBA_L

config ZMK_KEYBOARD_NAME
    string
    default "roBa_L"

config ZMK_SPLIT
    bool
    default y

# 左側はPeripheralなのでROLE_CENTRALの定義は不要

endif

if SHIELD_ROBA_R

config ZMK_KEYBOARD_NAME
    string
    default "roBa_R"

config ZMK_SPLIT
    bool
    default y

# 右側もPeripheralなのでROLE_CENTRALの定義は不要

endif

if SHIELD_ROBA_DONGLE

# キーボード名（最大16文字）
config ZMK_KEYBOARD_NAME
    string
    default "roBa_Dongle"

# 分割キーボード有効化
config ZMK_SPLIT
    bool
    default y

# 中央のドングルがCentralとして振る舞う
config ZMK_SPLIT_ROLE_CENTRAL
    bool
    default y

# 接続するPeripheralの数（左右なら2）
config ZMK_SPLIT_BLE_CENTRAL_PERIPHERALS
    int
    default 2

# Bluetoothの最大接続数 = Peripheral数 + Host数（例: PCやスマホ）
config BT_MAX_CONN
    int
    default 6

# ペアリング最大数（通常BT_MAX_CONNと同じ）
config BT_MAX_PAIRED
    int
    default 6

# エンコーダー（ロータリーエンコーダー）機能を有効化
config ZMK_BEHAVIOR_ROTARY_ENCODER
    bool "Enable rotary encoder behavior"
    default y

# トラックボールなどのマウスキー機能を有効化
config ZMK_BEHAVIOR_MOUSE_KEY
    bool "Enable mouse key behavior"
    default y

endif
```

## config/west.yml
```yaml
manifest:
  remotes:
    - name: zmkfirmware
      url-base: https://github.com/zmkfirmware
    # ★ あなたのGitHubアカウントを指すリモートを定義します
    - name: ryo-k-k  # ← ここは好きな名前でOKです（例: my-zmk-forks）
      url-base: https://github.com/ryo-k-k # ← ここにあなたのGitHubユーザー名を入れてください
    - name: carrefinho                            # <--- add this
      url-base: https://github.com/carrefinho     # <--- and this
  projects:
    - name: zmk
      remote: zmkfirmware
      revision: main
      import: app/west.yml
    - name: zmk-pmw3610-driver
      # ★ あなたのリモートとフォークしたリポジトリを指定します
      remote: ryo-k-k # ← 上で定義したリモート名
      revision: main              # ← フォークしたリポジトリのブランチ名（通常はmain）
    - name: prospector-zmk-module                 # <--- and these
      remote: carrefinho                          # <---
      revision: main                              # <---
  self:
    path: config
```
